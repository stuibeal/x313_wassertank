## x313_tank/sdkconfig.defaults
```kconfig
# Override some defaults so BT stack is enabled
CONFIG_BT_ENABLED=y
CONFIG_BTDM_CTRL_MODE_BLE_ONLY=n
CONFIG_BTDM_CTRL_MODE_BR_EDR_ONLY=y
CONFIG_BTDM_CTRL_MODE_BTDM=n
CONFIG_BT_CLASSIC_ENABLED=y
CONFIG_BT_SPP_ENABLED=y
CONFIG_BT_BLE_ENABLED=n
CONFIG_BT_BLUEDROID_ENABLED=y
CONFIG_BT_SSP_ENABLED=y # Enable Secure Simple Pairing
CONFIG_BT_CTRL_MODE_EFF=2 # ESP_BT_MODE_CLASSIC_BT or 3 for DUAL_MODE
CONFIG_BT_BLUEDROID_NAME="ROD-X313_Tank"
```
